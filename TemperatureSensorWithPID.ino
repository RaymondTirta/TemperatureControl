double targetTEMP = 24; 
char inputTEMP[2] ; 
double keypadTEMP = 0;
double outputPID;
double normalisasiPID;
unsigned long milli_time; 
float nilaiADC ;  
unsigned long rataADC; 
unsigned long CTexcel, CTdisplay, CTmeasure = 0;
unsigned long ITexcel = 1000;
unsigned long PTexcel = 0;
/*****************************
  SETUP UNTUK NILAI ADC VOLT
******************************/ 
#include <avr/pgmspace.h> //untuk menggunakan progmem diperlukan library ini.    
double hasilTEMP;
int voltPin = A0 ;    //Voltage reader pin 
const float ADC_TO_TEMP[1024] PROGMEM = {24.809, 24.8322, 24.8554, 24.8786, 24.9018, 24.925, 24.9482, 24.9714, 24.9946, 25.0178, 25.041, 25.0642, 25.0874,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 48.5156, 48.5388}
;                                                                                                       //PROGMEM const float yg dimasukkan array (PROGMEM AGAR MEMORI CUKUP) 
/*****************************
        END OF 
  SETUP UNTUK NILAI ADC VOLT
******************************/ 

/***************
  MILIS SETTING
 ***************/
unsigned long calculatingMillis = 0 ; //menyimpan waktu untuk mengkalkulasi millis
unsigned long previousMillis = 0;    //Menyimpan waktu terakhir di update 
long interval_nilaiADC = 1000;      //interval untuk menghitung ADC 1s
long interval_TimeAVG = 10;         //interval untuk menghitung ADC        

/*********************
  END OF MILIS SETTING
 *********************/

 
/*******************
 SERIAL I2C SETTING
 KEYPAD
 LiquidCrystal_I2C
 *******************/
#include <Wire.h>
#include <LiquidCrystal_I2C.h>
#include <Keypad.h>

const byte ROWS = 4;
const byte COLS = 4;
char hexaKeys[ROWS][COLS] = {           //Define Keypad Layout
  {'1', '2', '3', 'A'},
  {'4', '5', '6', 'B'},
  {'7', '8', '9', 'C'},
  {'*', '0', '#', 'D'}
};
byte rowPins[ROWS] = {9, 8, 7, 6}; //connect to the row pinouts of the keypad
byte colPins[COLS] = {5, 4, 3, 2}; //connect to the column pinouts of the keypad
Keypad keypad = Keypad( makeKeymap(hexaKeys), rowPins, colPins, ROWS, COLS );

LiquidCrystal_I2C lcd(0x27, 2, 1, 0, 4, 5, 6, 7, 3, POSITIVE); //i2C bus uses 
long current_time ; 
/*******************
      END OF
 SERIAL I2C SETTING
 KEYPAD
 LiquidCrystal_I2C
 *******************/

/**************
 PID CONTROLLER
 **************/
#include <PID_v1.h>
#define RELAY 10  
double inputPID;
double setpointPID; 
//Specify the links and initial tuning parameters
double kp = 9.10; double ki = 0.01; double kd = 1.9; 
PID myPID(&inputPID, &outputPID, &setpointPID, kp,ki,kd , DIRECT); //input,output,set , kp, ki, kd, direct 

int periode = 2000;
unsigned long startTime;
/*********************
 END OF PID CONTROLLER
 ****************** ***/
 double temp ;
   int loops ;
unsigned long currentMillis; 
int counter = 0; 
void setup() {
  Serial.begin(9600);   
  
  lcd.begin(16,2);                      //Starts LCD (x row, y column) 
  lcd.backlight();                      //Turn on backlight
  lcd.clear();                          //Clears LCD
  lcd.setCursor(0,0);                   //Move cursor (x right, y down)
  Serial.println("CLEARDATA"); //clears up any data left from previous projects

  Serial.println("LABEL,Suhu,Waktu"); //always write LABEL, so excel knows the next things will be the names of the columns (instead of Acolumn you could write Time for instance)

  Serial.println("RESETTIMER"); //resets timer to 0
  
  pinMode(10, OUTPUT);
  pinMode(A0, INPUT);          
   //PID
    startTime = millis();
    
    //tell the PID to range between 0 and the full window size
    myPID.SetOutputLimits(0, periode);

    //turn the PID on
    myPID.SetMode(AUTOMATIC);
  lcd.print("READY");                   //Signal for ready   
}

void loop() {       
 
   currentMillis = millis();                                                             // to check the time 
   
   if (currentMillis - previousMillis > interval_TimeAVG ){                                                                                                                                                                                                          
   previousMillis = currentMillis;   //mengenalkan variabel nilaiADC
   nilaiADC += analogRead(voltPin);   //read input pin dalam bit dan menambahnya terus
   counter = counter + 1; 
   if (counter >= 20 ){
   rataADC = nilaiADC/20; 
   hasilTEMP = pgm_read_float_near(ADC_TO_TEMP + rataADC); 
   nilaiADC = 0 ;  
   counter=0; 
   }                  
   }
    
    //mengeluarkan hasil float
   Serial.print("Temperature saat ini = ");Serial.print(hasilTEMP);Serial.println(" derajat celcius"); 
   lcd.setCursor(0,0);lcd.print("Tcur  : ");lcd.print(hasilTEMP);                                      //Output for temp reading 
   lcd.setCursor(0,1);lcd.print("Tset  : ");lcd.print(targetTEMP);                                     //Output analog reading
   
   
   //KEYPAD 
   
   char Key =keypad.getKey();
   if (Key == 'A'){                                                             //When "Enter" button is pushed 
    lcd.clear();
   KeyInput:                                                                    //Goto start of KeyInput
    lcd.setCursor(8,1);lcd.print("  ");                                        //Clear bottom line
    int data_count = 0;                                                        //Reset data_count
    do{
      Key = keypad.getKey();                                                      //Get Key from Keypad
      if (isdigit(Key)){                                                          //Check for input
        inputTEMP[data_count] = Key;                                              //Get input into char array
        lcd.setCursor(data_count,1);lcd.print(inputTEMP[data_count]);             //Output Key on LCD
        data_count++;                                                          
      }
     }while(data_count <2);
     keypadTEMP = atoi(inputTEMP);                                                  //Convert Char array to Integer
     if (keypadTEMP > 48 || keypadTEMP < 24){                                      //Check for invalid input
         currentMillis = millis();
         lcd.setCursor(0,1);lcd.print("ERROR");
         while(millis() < currentMillis + 2000);
         goto KeyInput;
     }
     targetTEMP = keypadTEMP;
   }
   if (Key == 'B'){
      lcd.clear();
      lcd.setCursor(0,0);lcd.print("PRESS A");                                      //Output for temp reading 
      lcd.setCursor(0,1);lcd.print("FOR TEMP SET");                                     //Output analog reading
   }
   if (Key == 'C'){
      lcd.clear();
      lcd.setCursor(0,0);lcd.print("PRESS A");                                      //Output for temp reading 
      lcd.setCursor(0,1);lcd.print("FOR TEMP SET");                                     //Output analog reading
   }
//output to excel 
 CTexcel = millis();
              if (CTexcel - PTexcel >= ITexcel) {
              PTexcel = CTexcel;
              Serial.print("DATA,");
              Serial.print(hasilTEMP);
              Serial.print(",");
              Serial.print("TIMER");
              Serial.print(",");
              Serial.println();
              }
 
//PID 
if(targetTEMP <= 35){
  kp = 8.82;
}
if(targetTEMP <= 40){
  kp = 9.22;
}
if(targetTEMP <= 45){
  kp = 8.67;
}
  myPID.Compute();
  inputPID = (int) (((hasilTEMP-24.809)/23.7298)*1024); 
  setpointPID = (int) (((targetTEMP-24.809)/23.7298)*1024); 
  /************************************************
   * turn the output pin on/off based on pid output
   ************************************************/
  if (millis() - startTime > periode)
  { //time to shift the Relay Window
    startTime += periode;
  }
  if (outputPID < millis() - startTime) 
  {
    digitalWrite(RELAY,HIGH);    //Turn off heater
  }
  else 
  {
    digitalWrite(RELAY,LOW);    //Turn on heater
  }
  Serial.println(outputPID);
}
